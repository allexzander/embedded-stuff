## yocto-custom-layers/meta-qt-simple-app/conf/layer.conf
```bitbake
# We have a conf and classes directory, add to BBPATH
BBPATH .= ":${LAYERDIR}"
LAYERSERIES_COMPAT_meta-qt-simple-app = "sumo"

# We have recipes-* directories, add to BBFILES
BBFILES += "${LAYERDIR}/recipes-*/*/*.bb \
            ${LAYERDIR}/recipes-*/*/*.bbappend"

BBFILE_COLLECTIONS += "meta-qt-simple-app"
BBFILE_PATTERN_meta-qt-simple-app = "^${LAYERDIR}/"
BBFILE_PRIORITY_meta-qt-simple-app = "6"

LAYERDEPENDS_meta-qt-simple-app = "core"
LAYERSERIES_COMPAT_meta-qt-simple-app = "mickledore"
```

## yocto-custom-layers/meta-qt-thermostatapp/conf/layer.conf
```bitbake
# We have a conf and classes directory, add to BBPATH
BBPATH .= ":${LAYERDIR}"
LAYERSERIES_COMPAT_meta-qt-thermostat-app = "sumo"

# We have recipes-* directories, add to BBFILES
BBFILES += "${LAYERDIR}/recipes-*/*/*.bb \
            ${LAYERDIR}/recipes-*/*/*.bbappend"

BBFILE_COLLECTIONS += "meta-qt-thermostat-app"
BBFILE_PATTERN_meta-qt-thermostat-app = "^${LAYERDIR}/"
BBFILE_PRIORITY_meta-qt-thermostat-app = "6"

LAYERDEPENDS_meta-qt-thermostat-app = "core"
LAYERSERIES_COMPAT_meta-qt-thermostat-app = "mickledore"
```

## yocto-custom-layers/meta-test-app/conf/layer.conf
```bitbake
# We have a conf and classes directory, add to BBPATH
BBPATH .= ":${LAYERDIR}"

# We have recipes-* directories, add to BBFILES
BBFILES += "${LAYERDIR}/recipes-*/*/*.bb \
            ${LAYERDIR}/recipes-*/*/*.bbappend"

BBFILE_COLLECTIONS += "meta-test-app"
BBFILE_PATTERN_meta-test-app = "^${LAYERDIR}/"
BBFILE_PRIORITY_meta-test-app = "6"

LAYERDEPENDS_meta-test-app = "core"
LAYERSERIES_COMPAT_meta-test-app = "mickledore nanbield"
```
